## config/west.yml
```yaml
manifest:
  remotes:
    - name: zmkfirmware
      url-base: https://github.com/esyo-net
  projects:
    - name: zmk
      remote: zmkfirmware
      revision: split_encoder
      import: app/west.yml
  self:
    path: config
```
